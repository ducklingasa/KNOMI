## spikes/display/main/Kconfig.projbuild
```kconfig
menu "KNOMI Phase 0.3 heap spike"

config KNOMI_SPIKE_WIFI_SSID
    string "Wi-Fi SSID"
    default ""

config KNOMI_SPIKE_WIFI_PASSWORD
    string "Wi-Fi password (stored in local sdkconfig)"
    default ""

config KNOMI_SPIKE_PRINTER_HOST
    string "Printer host"
    default "192.168.0.55"

config KNOMI_SPIKE_PRINTER_PORT
    int "Printer WebSocket port"
    range 1 65535
    default 9999

endmenu
```

## spikes/display/sdkconfig.defaults
```kconfig
CONFIG_IDF_TARGET="esp32s3"
CONFIG_ESPTOOLPY_FLASHMODE_DIO=y
CONFIG_ESPTOOLPY_FLASHFREQ_40M=y
CONFIG_ESPTOOLPY_FLASHSIZE_4MB=y
CONFIG_PARTITION_TABLE_CUSTOM=y
CONFIG_PARTITION_TABLE_CUSTOM_FILENAME="partitions.csv"
CONFIG_FREERTOS_HZ=1000
CONFIG_AUTOSTART_ARDUINO=n
CONFIG_ARDUINO_VARIANT="esp32s3"
CONFIG_ESP_DEFAULT_CPU_FREQ_MHZ_240=y
CONFIG_ESP_CONSOLE_USB_SERIAL_JTAG=y
CONFIG_SPIRAM=y
CONFIG_SPIRAM_MODE_QUAD=y
CONFIG_SPIRAM_SPEED_40M=y
CONFIG_SPIRAM_BOOT_INIT=y
CONFIG_SPIRAM_MEMTEST=y
CONFIG_SPIRAM_USE_MALLOC=y
```
